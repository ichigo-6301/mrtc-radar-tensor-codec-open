## configs/rdtc_v1_bounded_ab_direct_dc630_defconfig
```kconfig
CONFIG_RDTC_V1=y
CONFIG_RDTC_TOP="mrtc_rdtc_bounded_axis_multiengine_wrapper"
CONFIG_FLOW_PRODUCT_PROFILE="bounded-direct-register-expanded"
CONFIG_FLOW_TECHNOLOGY="nangate45_registers"
CONFIG_FLOW_CLOCK_PERIOD_NS="1.587302"
CONFIG_FLOW_DC_CLOCK_PERIOD_NS="1.587302"
CONFIG_FLOW_PNR_CLOCK_PERIOD_NS="1.587302"
CONFIG_FLOW_STA_CLOCK_PERIOD_NS="1.587302"
CONFIG_FLOW_SDC_TIME_SCALE="1.0"
CONFIG_FLOW_SDC_FILE="flows/constraints/rdtc_v1_bounded_sync_boundary_10pct.sdc"
CONFIG_FLOW_EXPECTED_STDCELL_DB_SHA256="c6da1f0e7a7f445c0476d1e6bf6860c9815fe4f50c9ce138264a581af59e4cb5"
CONFIG_FLOW_DC_MAX_CORES="4"
CONFIG_FLOW_BUILD_TAG="rdtc_v1_bounded_ab_direct_dc630"
CONFIG_FLOW_DC_HANDOFF_BUILD_TAG="rdtc_v1_bounded_ab_direct_dc630"
CONFIG_FLOW_MEMORY_MODE="registers"
# CONFIG_FLOW_BOUNDED_ASIC_REGISTER_EXPANDED is not set
CONFIG_FLOW_BOUNDED_DIRECT_ASIC_REGISTER_EXPANDED=y
# CONFIG_FLOW_BOUNDED_DIRECT_ASIC_SRAM is not set
CONFIG_FLOW_DC_FORBID_RETIME=y
CONFIG_FLOW_OPENROAD_PLATFORM="nangate45"
CONFIG_FLOW_PNR_BACKEND="openroad"
CONFIG_FLOW_PNR_SCOPE="full"
CONFIG_FLOW_DC_BASELINE=y
# CONFIG_FLOW_DC_GATED is not set
# CONFIG_FLOW_PNR is not set
# CONFIG_FLOW_STA is not set
```

## configs/rdtc_v1_bounded_direct_register_dc630_pnr600_defconfig
```kconfig
CONFIG_RDTC_V1=y
CONFIG_RDTC_TOP="mrtc_rdtc_bounded_axis_multiengine_wrapper"
CONFIG_FLOW_PRODUCT_PROFILE="bounded-direct-register-expanded"
CONFIG_FLOW_TECHNOLOGY="nangate45_registers"
CONFIG_FLOW_CLOCK_PERIOD_NS="1.666667"
CONFIG_FLOW_DC_CLOCK_PERIOD_NS="1.587302"
CONFIG_FLOW_PNR_CLOCK_PERIOD_NS="1.666667"
CONFIG_FLOW_STA_CLOCK_PERIOD_NS="1.666667"
CONFIG_FLOW_SDC_TIME_SCALE="1.0"
CONFIG_FLOW_SDC_FILE="flows/constraints/rdtc_v1_direct_axis_sync_boundary.sdc"
CONFIG_FLOW_SETUP_SLACK_MARGIN_NS="0.00"
CONFIG_FLOW_HOLD_SLACK_MARGIN_NS="0.06"
CONFIG_FLOW_CAP_MARGIN_PERCENT="60"
CONFIG_FLOW_SLEW_MARGIN_PERCENT="65"
CONFIG_FLOW_GRT_HOLD_SLACK_MARGIN_NS="0.00"
CONFIG_FLOW_POST_GRT_HOLD_REPAIR_PASSES="0"
CONFIG_FLOW_BUILD_TAG="rdtc_v1_bounded_direct_register_dc630_pnr600_syncio10"
CONFIG_FLOW_DC_HANDOFF_BUILD_TAG="rdtc_v1_bounded_direct_register_dc630_pnr600_syncio10"
CONFIG_FLOW_MEMORY_MODE="registers"
# CONFIG_FLOW_BOUNDED_ASIC_REGISTER_EXPANDED is not set
# CONFIG_FLOW_BOUNDED_ASIC_SRAM is not set
CONFIG_FLOW_BOUNDED_DIRECT_ASIC_REGISTER_EXPANDED=y
# CONFIG_FLOW_BOUNDED_DIRECT_ASIC_SRAM is not set
CONFIG_FLOW_DC_FORBID_RETIME=y
# CONFIG_FLOW_FULL_BLOCK_ENCODER is not set
# CONFIG_FLOW_USE_OPENRAM_BLOCK_SRAM_1RW32X4 is not set
# CONFIG_FLOW_BLOCK_SRAM_DOUT_PIPELINE is not set
# CONFIG_FLOW_PREFIX_SRAM_DOUT_PIPELINE is not set
CONFIG_FLOW_OPENROAD_PLATFORM="nangate45"
CONFIG_FLOW_PNR_BACKEND="openroad"
CONFIG_FLOW_PNR_SCOPE="full"
# CONFIG_FLOW_LIBRARY_PREP is not set
# CONFIG_FLOW_SRAM_PREP is not set
# CONFIG_FLOW_RC_PREP is not set
# CONFIG_FLOW_RTL_SIM is not set
# CONFIG_FLOW_LINT is not set
# CONFIG_FLOW_CDC is not set
CONFIG_FLOW_DC_BASELINE=y
# CONFIG_FLOW_DC_GATED is not set
# CONFIG_FLOW_DFT is not set
# CONFIG_FLOW_LEC is not set
# CONFIG_FLOW_ICC2_LIBS is not set
CONFIG_FLOW_PNR=y
CONFIG_FLOW_STA=y
```
