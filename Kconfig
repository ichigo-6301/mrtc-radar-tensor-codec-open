## Kconfig
```kconfig
mainmenu "MRTC RDTC v1 implementation flow"

config RDTC_V1
	bool "Enable the RDTC v1 public release profile"
	default y

config RDTC_TOP
	string "Elaboration top module"
	default "mrtc_rdtc_wb_wrapper"

menu "Implementation profile"

config FLOW_PRODUCT_PROFILE
	string "Implementation product profile"
	default "sram-macro"
	help
		Use register-expanded when the prefix buffer is mapped into standard
		cells, or sram-macro when the two 64x128 hard memories are bound.

config FLOW_TECHNOLOGY
	string "Technology and memory-planning label"
	default "freepdk45_openram"

config FLOW_CLOCK_PERIOD_NS
	string "Legacy/default target clock period in ns"
	default "2.500"
	help
		Used as the fallback for synthesis, physical implementation, and
		STA when the stage-specific period below is empty.

config FLOW_SDC_TIME_SCALE
	string "Scale from documented ns to library time units"
	default "1.0"
	help
		Use 1000.0 for libraries whose Liberty time_unit is 1ps. Documented
		clock periods remain in ns; the constraint adapter applies this scale.

config FLOW_DC_CLOCK_PERIOD_NS
	string "Design Compiler clock period in ns"
	default ""
	help
		Optional synthesis-only target. A tighter DC target can provide a
		faster mapped netlist for a looser physical implementation target.

config FLOW_PNR_CLOCK_PERIOD_NS
	string "Physical implementation clock period in ns"
	default ""
	help
		Optional OpenROAD/ICC2 target applied when the mapped netlist is
		imported. Leave empty to use the legacy/default period.

config FLOW_STA_CLOCK_PERIOD_NS
	string "Post-route STA clock period in ns"
	default ""
	help
		Expected PrimeTime analysis period. It normally matches the P&R
		period and is recorded separately to make the handoff auditable.

config FLOW_HOLD_SLACK_MARGIN_NS
	string "OpenROAD CTS hold repair slack margin in ns"
	default "-0.05"
	help
		Set the physical implementation hold-repair target independently of
		the synthesis clock period. Use 0.00 for hold-closure experiments.

config FLOW_SETUP_SLACK_MARGIN_NS
	string "OpenROAD setup repair slack margin in ns"
	default "0.00"
	help
		Reserve bounded setup margin during physical optimization so routed
		and extracted timing drift does not consume a zero-slack result.

config FLOW_CAP_MARGIN_PERCENT
	string "OpenROAD max-capacitance repair margin in percent"
	default ""
	help
		Optionally over-fix max capacitance during global-route repair to
		cover detailed-route extraction drift. Empty preserves the platform
		default; record non-empty values as a physical guardband experiment.

config FLOW_SLEW_MARGIN_PERCENT
	string "OpenROAD max-transition repair margin in percent"
	default ""
	help
		Optionally over-fix max transition during global-route repair to
		cover detailed-route extraction drift. Empty preserves the platform
		default; record non-empty values as a physical guardband experiment.

config FLOW_GRT_HOLD_SLACK_MARGIN_NS
	string "OpenROAD global-route hold repair slack margin in ns"
	default ""
	help
		Override the CTS hold guardband when global routing starts. Leave
		empty to preserve the CTS margin, or use 0.00 to repair only actual
		global-route hold violations after a guarded CTS run.

config FLOW_POST_GRT_HOLD_REPAIR_PASSES
	string "Post-global-route incremental hold repair passes"
	default "0"
	help
		Run bounded hold repair and incremental rerouting after the normal
		global-route repair sequence. Zero preserves the baseline flow.

config FLOW_POST_GRT_HOLD_SLACK_MARGIN_NS
	string "Post-global-route hold repair slack margin in ns"
	default "0.00"
	help
		Apply a local guardband only during the bounded post-global-route
		repair passes so detailed-route parasitics do not reopen hold paths.

config FLOW_TARGETED_DRC_ECO
	string "Profile-specific pre-detail-route DRC ECO"
	default ""
	help
		Select a reviewed, fail-closed physical ECO by name. Leave empty for
		the generic flow. The rdtc333_spice_eco1 option is tied to the pinned
		333 MHz mapped-netlist and OpenROAD profile.

config FLOW_EXPECTED_DC_NETLIST_SHA256
	string "Expected mapped DC netlist SHA256"
	default ""
	help
		Optional fail-closed identity check for a physical implementation
		handoff. Leave empty for exploratory profiles.

config FLOW_DC_HANDOFF_BUILD_TAG
	string "Build tag containing the mapped DC handoff"
	default ""
	help
		Use a separate physical build tag when a P&R guardband iteration
		reuses a frozen DC netlist from another ignored build directory.

config FLOW_STA_UNUSED_RW_DOUT_MIN_CAP_WAIVER
	bool "Waive unused 1RW1R dout0 minimum-capacitance checks"
	default n
	help
		Allow only the exact 256 minimum-capacitance checks on the unused
		dout0[127:0] bus of the two RDTC 1RW1R SRAM instances. Any missing,
		extra, or differently named violation still fails post-route STA.

config FLOW_BUILD_TAG
	string "Ignored build directory tag"
	default "rdtc_v1_45nm"

config FLOW_MEMORY_MODE
	string "Prefix-buffer implementation"
	default "macro"
	help
		Use macro for a technology memory leaf or registers for the
		standard-cell-expanded comparison profile.

config FLOW_TSMC90_MEMORY_VARIANT
	string "TSMC90 prefix-memory variant"
	default "rf64x128"
	help
		Use rf64x128 for the exact-depth two-port register-file macro or
		sram128x128 for the true dual-port SRAM with its upper address bit
		tied low. This setting is ignored by non-TSMC90 profiles.

config FLOW_OPENROAD_PLATFORM
	string "ORFS platform name"
	default "nangate45"

config FLOW_PNR_BACKEND
	string "Physical implementation backend"
	default "openroad"
	help
		Use openroad for the reproducible academic profile or icc2 for the
		Synopsys-only vendor-PDK profile.

config FLOW_PNR_SCOPE
	string "Physical implementation scope"
	default "full"

endmenu

menu "Enabled stages"

config FLOW_LIBRARY_PREP
	bool "Compile and audit technology standard-cell libraries"
	default n

config FLOW_SRAM_PREP
	bool "Memory macro preparation, audit, and Library Compiler DB"
	default y

config FLOW_RC_PREP
	bool "FreePDK45 academic ITF and TLUPlus generation"
	default n

config FLOW_RTL_SIM
	bool "Questa/ModelSim RTL regression smoke"
	default y

config FLOW_LINT
	bool "SpyGlass RTL lint"
	default y

config FLOW_CDC
	bool "SpyGlass CDC/RDC"
	default y

config FLOW_DC_BASELINE
	bool "Design Compiler baseline synthesis"
	default y

config FLOW_DC_GATED
	bool "Design Compiler clock-gated synthesis"
	default y

config FLOW_DFT
	bool "Scan DFT insertion"
	default y

config FLOW_LEC
	bool "Formal equivalence checking"
	default y

config FLOW_PNR
	bool "OpenROAD/OpenRCX physical implementation"
	default n

config FLOW_ICC2_LIBS
	bool "ICC2 Library Manager reference-library build"
	default n

config FLOW_STA
	bool "PrimeTime post-layout STA"
	default n

endmenu
```

## configs/rdtc_v1_45nm_dc900mapped_pnr333_spice_guardband_eco1_defconfig
```kconfig
CONFIG_RDTC_V1=y
CONFIG_RDTC_TOP="mrtc_rdtc_wb_wrapper"
CONFIG_FLOW_TECHNOLOGY="nangate45_openram_spice"
CONFIG_FLOW_CLOCK_PERIOD_NS="3.000"
CONFIG_FLOW_DC_CLOCK_PERIOD_NS="1.111"
CONFIG_FLOW_PNR_CLOCK_PERIOD_NS="3.000"
CONFIG_FLOW_STA_CLOCK_PERIOD_NS="3.000"
CONFIG_FLOW_SETUP_SLACK_MARGIN_NS="0.00"
CONFIG_FLOW_HOLD_SLACK_MARGIN_NS="0.06"
CONFIG_FLOW_CAP_MARGIN_PERCENT="60"
CONFIG_FLOW_SLEW_MARGIN_PERCENT="65"
CONFIG_FLOW_GRT_HOLD_SLACK_MARGIN_NS="0.00"
CONFIG_FLOW_POST_GRT_HOLD_REPAIR_PASSES="0"
CONFIG_FLOW_POST_GRT_HOLD_SLACK_MARGIN_NS="0.00"
CONFIG_FLOW_TARGETED_DRC_ECO="rdtc333_spice_eco1"
CONFIG_FLOW_STA_UNUSED_RW_DOUT_MIN_CAP_WAIVER=y
CONFIG_FLOW_BUILD_TAG="rdtc_v1_45nm_dc900mapped_pnr333_spice_guardband_eco1_1rw1r"
CONFIG_FLOW_MEMORY_MODE="macro"
CONFIG_FLOW_OPENROAD_PLATFORM="nangate45"
CONFIG_FLOW_PNR_BACKEND="openroad"
CONFIG_FLOW_PNR_SCOPE="full"
CONFIG_FLOW_SRAM_PREP=y
# CONFIG_FLOW_RC_PREP is not set
# CONFIG_FLOW_RTL_SIM is not set
# CONFIG_FLOW_LINT is not set
# CONFIG_FLOW_CDC is not set
CONFIG_FLOW_DC_BASELINE=y
# CONFIG_FLOW_DC_GATED is not set
# CONFIG_FLOW_DFT is not set
# CONFIG_FLOW_LEC is not set
# CONFIG_FLOW_ICC2_LIBS is not set
CONFIG_FLOW_PNR=y
CONFIG_FLOW_STA=y
```

## configs/rdtc_v1_45nm_dc900mapped_pnr700_defconfig
```kconfig
CONFIG_RDTC_V1=y
CONFIG_RDTC_TOP="mrtc_rdtc_wb_wrapper"
CONFIG_FLOW_TECHNOLOGY="nangate45_openram"
CONFIG_FLOW_CLOCK_PERIOD_NS="1.429"
CONFIG_FLOW_DC_CLOCK_PERIOD_NS="1.111"
CONFIG_FLOW_PNR_CLOCK_PERIOD_NS="1.429"
CONFIG_FLOW_STA_CLOCK_PERIOD_NS="1.429"
CONFIG_FLOW_SETUP_SLACK_MARGIN_NS="0.00"
CONFIG_FLOW_HOLD_SLACK_MARGIN_NS="0.02"
CONFIG_FLOW_GRT_HOLD_SLACK_MARGIN_NS="0.00"
CONFIG_FLOW_POST_GRT_HOLD_REPAIR_PASSES="0"
CONFIG_FLOW_POST_GRT_HOLD_SLACK_MARGIN_NS="0.00"
CONFIG_FLOW_BUILD_TAG="rdtc_v1_45nm_dc900mapped_pnr700"
CONFIG_FLOW_MEMORY_MODE="macro"
CONFIG_FLOW_OPENROAD_PLATFORM="nangate45"
CONFIG_FLOW_PNR_BACKEND="openroad"
CONFIG_FLOW_PNR_SCOPE="full"
CONFIG_FLOW_SRAM_PREP=y
# CONFIG_FLOW_RC_PREP is not set
# CONFIG_FLOW_RTL_SIM is not set
# CONFIG_FLOW_LINT is not set
# CONFIG_FLOW_CDC is not set
CONFIG_FLOW_DC_BASELINE=y
# CONFIG_FLOW_DC_GATED is not set
# CONFIG_FLOW_DFT is not set
# CONFIG_FLOW_LEC is not set
# CONFIG_FLOW_ICC2_LIBS is not set
CONFIG_FLOW_PNR=y
CONFIG_FLOW_STA=y
```

## configs/rdtc_v1_45nm_defconfig
```kconfig
CONFIG_RDTC_V1=y
CONFIG_RDTC_TOP="mrtc_rdtc_wb_wrapper"
CONFIG_FLOW_PRODUCT_PROFILE="sram-macro"
CONFIG_FLOW_TECHNOLOGY="nangate45_openram"
CONFIG_FLOW_CLOCK_PERIOD_NS="2.500"
CONFIG_FLOW_BUILD_TAG="rdtc_v1_45nm"
CONFIG_FLOW_MEMORY_MODE="macro"
CONFIG_FLOW_OPENROAD_PLATFORM="nangate45"
CONFIG_FLOW_PNR_BACKEND="openroad"
CONFIG_FLOW_PNR_SCOPE="full"
CONFIG_FLOW_SRAM_PREP=y
# CONFIG_FLOW_RC_PREP is not set
CONFIG_FLOW_RTL_SIM=y
CONFIG_FLOW_LINT=y
# CONFIG_FLOW_CDC is not set
CONFIG_FLOW_DC_BASELINE=y
# CONFIG_FLOW_DC_GATED is not set
# CONFIG_FLOW_DFT is not set
# CONFIG_FLOW_LEC is not set
# CONFIG_FLOW_ICC2_LIBS is not set
CONFIG_FLOW_PNR=y
CONFIG_FLOW_STA=y
```

## configs/rdtc_v1_public_preflight_defconfig
```kconfig
CONFIG_RDTC_V1=y
CONFIG_RDTC_TOP="mrtc_rdtc_wb_wrapper"
CONFIG_FLOW_PRODUCT_PROFILE="register-expanded"
CONFIG_FLOW_TECHNOLOGY="public_preflight"
CONFIG_FLOW_CLOCK_PERIOD_NS="2.500"
CONFIG_FLOW_BUILD_TAG="rdtc_v1_public_preflight"
CONFIG_FLOW_MEMORY_MODE="registers"
CONFIG_FLOW_OPENROAD_PLATFORM=""
CONFIG_FLOW_PNR_BACKEND="openroad"
CONFIG_FLOW_PNR_SCOPE="full"
# CONFIG_FLOW_LIBRARY_PREP is not set
# CONFIG_FLOW_SRAM_PREP is not set
# CONFIG_FLOW_RC_PREP is not set
# CONFIG_FLOW_RTL_SIM is not set
CONFIG_FLOW_PUBLIC_RTL_SMOKE=y
# CONFIG_FLOW_LINT is not set
# CONFIG_FLOW_CDC is not set
# CONFIG_FLOW_DC_BASELINE is not set
# CONFIG_FLOW_DC_GATED is not set
# CONFIG_FLOW_DFT is not set
# CONFIG_FLOW_LEC is not set
# CONFIG_FLOW_ICC2_LIBS is not set
# CONFIG_FLOW_PNR is not set
# CONFIG_FLOW_STA is not set
```

## configs/rdtc_v1_register_45nm_800m_defconfig
```kconfig
CONFIG_RDTC_V1=y
CONFIG_RDTC_TOP="mrtc_rdtc_wb_wrapper"
CONFIG_FLOW_PRODUCT_PROFILE="register-expanded"
CONFIG_FLOW_TECHNOLOGY="nangate45_registers"
CONFIG_FLOW_CLOCK_PERIOD_NS="1.250"
CONFIG_FLOW_DC_CLOCK_PERIOD_NS="1.250"
CONFIG_FLOW_PNR_CLOCK_PERIOD_NS="1.250"
CONFIG_FLOW_STA_CLOCK_PERIOD_NS="1.250"
CONFIG_FLOW_BUILD_TAG="rdtc_v1_register_45nm_800m"
CONFIG_FLOW_MEMORY_MODE="registers"
CONFIG_FLOW_OPENROAD_PLATFORM="nangate45"
CONFIG_FLOW_PNR_BACKEND="openroad"
CONFIG_FLOW_PNR_SCOPE="full"
# CONFIG_FLOW_LIBRARY_PREP is not set
# CONFIG_FLOW_SRAM_PREP is not set
# CONFIG_FLOW_RC_PREP is not set
# CONFIG_FLOW_RTL_SIM is not set
# CONFIG_FLOW_LINT is not set
# CONFIG_FLOW_CDC is not set
CONFIG_FLOW_DC_BASELINE=y
# CONFIG_FLOW_DC_GATED is not set
# CONFIG_FLOW_DFT is not set
# CONFIG_FLOW_LEC is not set
# CONFIG_FLOW_ICC2_LIBS is not set
# CONFIG_FLOW_PNR is not set
# CONFIG_FLOW_STA is not set
```

## configs/rdtc_v1_register_45nm_dc600_pnr400_defconfig
```kconfig
CONFIG_RDTC_V1=y
CONFIG_RDTC_TOP="mrtc_rdtc_wb_wrapper"
CONFIG_FLOW_PRODUCT_PROFILE="register-expanded"
CONFIG_FLOW_TECHNOLOGY="nangate45_registers"
CONFIG_FLOW_CLOCK_PERIOD_NS="2.500"
CONFIG_FLOW_DC_CLOCK_PERIOD_NS="1.666667"
CONFIG_FLOW_PNR_CLOCK_PERIOD_NS="2.500"
CONFIG_FLOW_STA_CLOCK_PERIOD_NS="2.500"
CONFIG_FLOW_SDC_TIME_SCALE="1.0"
CONFIG_FLOW_SETUP_SLACK_MARGIN_NS="0.00"
CONFIG_FLOW_HOLD_SLACK_MARGIN_NS="0.06"
CONFIG_FLOW_GRT_HOLD_SLACK_MARGIN_NS="0.00"
CONFIG_FLOW_POST_GRT_HOLD_REPAIR_PASSES="0"
CONFIG_FLOW_BUILD_TAG="rdtc_v1_register_45nm_600m"
CONFIG_FLOW_EXPECTED_DC_NETLIST_SHA256="715fcb1b02135e213589939635e66097536008d0d37394f31cde30c501d4affe"
CONFIG_FLOW_MEMORY_MODE="registers"
CONFIG_FLOW_OPENROAD_PLATFORM="nangate45"
CONFIG_FLOW_PNR_BACKEND="openroad"
CONFIG_FLOW_PNR_SCOPE="full"
# CONFIG_FLOW_LIBRARY_PREP is not set
# CONFIG_FLOW_SRAM_PREP is not set
# CONFIG_FLOW_RC_PREP is not set
# CONFIG_FLOW_RTL_SIM is not set
# CONFIG_FLOW_LINT is not set
# CONFIG_FLOW_CDC is not set
# CONFIG_FLOW_DC_BASELINE is not set
# CONFIG_FLOW_DC_GATED is not set
# CONFIG_FLOW_DFT is not set
# CONFIG_FLOW_LEC is not set
# CONFIG_FLOW_ICC2_LIBS is not set
CONFIG_FLOW_PNR=y
CONFIG_FLOW_STA=y
```

## configs/rdtc_v1_register_45nm_dc700_pnr550_cap60_defconfig
```kconfig
CONFIG_RDTC_V1=y
CONFIG_RDTC_TOP="mrtc_rdtc_wb_wrapper"
CONFIG_FLOW_PRODUCT_PROFILE="register-expanded"
CONFIG_FLOW_TECHNOLOGY="nangate45_registers"
CONFIG_FLOW_CLOCK_PERIOD_NS="1.818182"
CONFIG_FLOW_DC_CLOCK_PERIOD_NS="1.428571"
CONFIG_FLOW_PNR_CLOCK_PERIOD_NS="1.818182"
CONFIG_FLOW_STA_CLOCK_PERIOD_NS="1.818182"
CONFIG_FLOW_SDC_TIME_SCALE="1.0"
CONFIG_FLOW_SETUP_SLACK_MARGIN_NS="0.00"
CONFIG_FLOW_HOLD_SLACK_MARGIN_NS="0.06"
CONFIG_FLOW_CAP_MARGIN_PERCENT="60"
CONFIG_FLOW_SLEW_MARGIN_PERCENT="65"
CONFIG_FLOW_GRT_HOLD_SLACK_MARGIN_NS="0.00"
CONFIG_FLOW_POST_GRT_HOLD_REPAIR_PASSES="0"
CONFIG_FLOW_BUILD_TAG="rdtc_v1_register_45nm_dc700_pnr550_cap60"
CONFIG_FLOW_DC_HANDOFF_BUILD_TAG="rdtc_v1_register_45nm_700m"
CONFIG_FLOW_EXPECTED_DC_NETLIST_SHA256="75e093a1b1d8689bb24fc637669859ccc67a6311838092388270f1575b6a2b41"
CONFIG_FLOW_MEMORY_MODE="registers"
CONFIG_FLOW_OPENROAD_PLATFORM="nangate45"
CONFIG_FLOW_PNR_BACKEND="openroad"
CONFIG_FLOW_PNR_SCOPE="full"
# CONFIG_FLOW_LIBRARY_PREP is not set
# CONFIG_FLOW_SRAM_PREP is not set
# CONFIG_FLOW_RC_PREP is not set
# CONFIG_FLOW_RTL_SIM is not set
# CONFIG_FLOW_LINT is not set
# CONFIG_FLOW_CDC is not set
# CONFIG_FLOW_DC_BASELINE is not set
# CONFIG_FLOW_DC_GATED is not set
# CONFIG_FLOW_DFT is not set
# CONFIG_FLOW_LEC is not set
# CONFIG_FLOW_ICC2_LIBS is not set
CONFIG_FLOW_PNR=y
CONFIG_FLOW_STA=y
```

## configs/rdtc_v1_sky130_macro_200m_defconfig
```kconfig
CONFIG_RDTC_V1=y
CONFIG_RDTC_TOP="mrtc_rdtc_wb_wrapper"
CONFIG_FLOW_TECHNOLOGY="sky130hd_pdk_sram"
CONFIG_FLOW_CLOCK_PERIOD_NS="5.000"
CONFIG_FLOW_BUILD_TAG="rdtc_v1_sky130_macro_200m"
CONFIG_FLOW_MEMORY_MODE="macro"
CONFIG_FLOW_OPENROAD_PLATFORM="sky130hd"
CONFIG_FLOW_PNR_BACKEND="openroad"
CONFIG_FLOW_PNR_SCOPE="full"
CONFIG_FLOW_LIBRARY_PREP=y
CONFIG_FLOW_SRAM_PREP=y
# CONFIG_FLOW_RC_PREP is not set
CONFIG_FLOW_RTL_SIM=y
CONFIG_FLOW_LINT=y
# CONFIG_FLOW_CDC is not set
CONFIG_FLOW_DC_BASELINE=y
# CONFIG_FLOW_DC_GATED is not set
# CONFIG_FLOW_DFT is not set
# CONFIG_FLOW_LEC is not set
CONFIG_FLOW_PNR=y
# CONFIG_FLOW_ICC2_LIBS is not set
CONFIG_FLOW_STA=y
```

## configs/rdtc_v1_tsmc90_sram128x128_partial_defconfig
```kconfig
CONFIG_RDTC_V1=y
CONFIG_RDTC_TOP="mrtc_rdtc_wb_wrapper"
CONFIG_FLOW_TECHNOLOGY="tsmc90_aci_core_1p0v_9lm2thick"
CONFIG_FLOW_CLOCK_PERIOD_NS="2.500"
CONFIG_FLOW_DC_CLOCK_PERIOD_NS="2.500"
CONFIG_FLOW_PNR_CLOCK_PERIOD_NS="2.500"
CONFIG_FLOW_STA_CLOCK_PERIOD_NS="2.500"
CONFIG_FLOW_BUILD_TAG="rdtc_v1_tsmc90_sram128x128_partial"
CONFIG_FLOW_MEMORY_MODE="macro"
CONFIG_FLOW_TSMC90_MEMORY_VARIANT="sram128x128"
CONFIG_FLOW_PNR_BACKEND="icc2"
CONFIG_FLOW_PNR_SCOPE="floorplan_only"
CONFIG_FLOW_SRAM_PREP=y
# CONFIG_FLOW_RC_PREP is not set
CONFIG_FLOW_RTL_SIM=y
CONFIG_FLOW_LINT=y
# CONFIG_FLOW_CDC is not set
CONFIG_FLOW_DC_BASELINE=y
# CONFIG_FLOW_DC_GATED is not set
# CONFIG_FLOW_DFT is not set
# CONFIG_FLOW_LEC is not set
CONFIG_FLOW_ICC2_LIBS=y
CONFIG_FLOW_PNR=y
# CONFIG_FLOW_STA is not set
```
